


#include <Wire.h>  // Only needed for Arduino 1.6.5 and earlier
#include "SSD1306Wire.h" // legacy include: `#include "SSD1306.h"`

#include <NTPClient.h>
#include <WiFiUdp.h>

#include <ESP8266WiFi.h>
#include <WiFiClient.h>
#include <ESP8266WebServer.h>
#include <ESP8266mDNS.h>


//Week Days
String weekDays[7]={"Sunday", "Monday", "Tuesday", "Wednesday", "Thursday", "Friday", "Saturday"};

//Month names
String months[12]={"January", "February", "March", "April", "May", "June", "July", "August", "September", "October", "November", "December"};

const char* ssid = "Nguyen Tiem";      //"Nguyen Tiem";
const char* password = "58642110";       //"58642110";

WiFiServer server(88);
IPAddress staticIP(192, 168, 1, 22);
IPAddress gateway(192, 168, 1, 1);
IPAddress subnet(255, 255, 255, 0);

WiFiUDP ntpUDP;
NTPClient timeClient(ntpUDP, "pool.ntp.org");







int screenW = 128;
int screenH = 64;
int clockCenterX = screenW/2;
int clockCenterY = ((screenH-16)/2)+8;   // top yellow part is 16 px height
int clockRadius = 32;
int currentHour ; 
int currentMinute ; 
int currentSecond ;
String weekDay ;
int monthDay ;
int currentMonth ;
String currentMonthName ;
int currentYear ;
int n = 0 ;

String mess;
int red = D5;
int green = D6;
int blue = D7;
int frame = 53;
int pwmr = 53 , pwmb = 53, pwmg = 53;

SSD1306Wire  display(0x3c, D2, D1);


static const unsigned char PROGMEM logo_bmp[] =
{ B01111111, B11111111, B11111111, B11111111, B11111111, B11111111, B11111111, B11111111, B11111111, B11111111, B11111111, B11111111, B11111111, B11111111, B11111111,
  B01111111, B11111111, B11111111, B11111111, B11111111, B11111111, B11111111, B11111111, B11111111, B11111111, B11111111, B11111111, B11111111, B11111111, B11111111,
  B01111111, B11111111, B11111111, B11111111, B11111111, B11111111, B11111111, B11111111, B11111111, B11111111, B11111111, B11111111, B11111111, B11111111, B11111111,
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  B01111111, B11111001, B11000000, B00000001, B01111111, B11111111, B11111111, B11111111, B11111111, B11111111, B11111111, B11111111, B11111111, B11111111, B11000000

};  //icon

static const unsigned char PROGMEM logo_bmp1[] = {
  B01111111, B11111111, B11111111, B11111111, B11111111, B11111111, B11111111, B11111111, B11111111, B11111111, B11111111, B11111111, B11111111, B11111111, B11110000,
  B01111111, B11111111, B11111111, B11111111, B11111111, B11111111, B11111111, B11111111, B11111111, B11111111, B11111111, B11111111, B11111111, B11111111, B11110000,
  B01111111, B11111111, B11111111, B11111111, B11111111, B11111111, B11111111, B11111111, B11111111, B11111111, B11111111, B11111111, B11111111, B11111111, B11110000,
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  B01000000, B00000000, B00000000, B00000000, B00000000, B00000000, B00000000, B00000111, B10000000, B00110000, B00000000, B00000000, B00000000, B00000000, B00000000
};


static const unsigned char PROGMEM logo_bmp2[] = {
  B01111111, B11111000, B00000000, B00000000, B00000111, B11100000, B00000001, B11111111, B11111111, B11111111, B11100001, B11111111, B11111111, B11111111, B11111111, B10000000,
  B01111111, B11111000, B00000000, B00000000, B00000111, B11100000, B00000001, B11111111, B11111111, B11111111, B11100001, B11111111, B11111111, B11111111, B11111111, B10000000,
  B01111111, B11111000, B00000000, B00000000, B00000111, B11000000, B00000000, B11111111, B11111111, B11111111, B11100001, B11111111, B11111111, B11111111, B11111111, B10000000,
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  B00000000, B00000000, B00000000, B00000000, B01100000, B00000000, B00001111, B11111111, B11111111, B11111111, B11111000, B00000000, B00011111, B11111111, B11111111, B10000000

};



void testdrawbitmap(const uint8_t bitmap[], int16_t LOGO_HEIGHT, int16_t LOGO_WIDTH ) {
  display.clear();
  display.drawXbm(
    0,
    0,
    LOGO_WIDTH, LOGO_HEIGHT, bitmap);
  display.display();

}

void analogClockFrame( ) {
  display.clear();
  display.drawCircle(clockCenterX , clockCenterY ,2);
  
  for( int z=0; z < 360;z= z + 30 ){
  //Begin at 0° and stop at 360°
    float angle = z ;
    angle = ( angle / 57.29577951 ) ; //Convert degrees to radians
    int x2 = ( clockCenterX + ( sin(angle) * clockRadius ) );
    int y2 = ( clockCenterY - ( cos(angle) * clockRadius ) );
    int x3 = ( clockCenterX + ( sin(angle) * ( clockRadius - ( clockRadius / 8 ) ) ) );
    int y3 = ( clockCenterY - ( cos(angle) * ( clockRadius - ( clockRadius / 8 ) ) ) );
    display.drawLine( x2 , y2  , x3  , y3);
  }
 for( int z=90; z <= 360;z= z + 90 ){
  //Begin at 0° and stop at 360°
  float angle ;
  float rad;
  if(z==90){
     angle = z-15 ;
     rad= clockRadius-8;
    }
    if(z ==180){
     angle = z+8 ;
     rad= clockRadius-13;
    }
    if(z==270){
     angle = z+15 ;
     rad= clockRadius-6;
    }
    if(z ==360){
     angle = z-10 ;
     rad= clockRadius-2;
    }
  
 
    
    angle = ( angle / 57.29577951 ) ; //Convert degrees to radians
    int x_2 = ( clockCenterX + ( sin(angle) * rad ) );
    int y_2 = ( clockCenterY - ( cos(angle) * rad ) );
    
  display.setFont(ArialMT_Plain_10);
  display.drawString(x_2, y_2, String(z/30));
  }
  // display second hand
  float angle = currentSecond * 6 ;
  angle = ( angle / 57.29577951 ) ; 
  int x3 = ( clockCenterX + ( sin(angle) * ( clockRadius - ( clockRadius / 5 ) ) ) );
  int y3 = ( clockCenterY - ( cos(angle) * ( clockRadius - ( clockRadius / 5 ) ) ) );
  display.drawLine( clockCenterX  , clockCenterY  , x3  , y3 );
  //
  // display minute hand
  angle = currentMinute * 6 ;
  angle = ( angle / 57.29577951 ) ; //Convert degrees to radians
  x3 = ( clockCenterX + ( sin(angle) * ( clockRadius - ( clockRadius / 4 ) ) ) );
  y3 = ( clockCenterY - ( cos(angle) * ( clockRadius - ( clockRadius / 4 ) ) ) );
  display.drawLine( clockCenterX  , clockCenterY  , x3  , y3 );
 
  // display hour hand
  angle = currentHour* 30 + int( (currentMinute / 12 ) * 6 )   ;
  angle = ( angle / 57.29577951 ) ; //Convert degrees to radians
  x3 = ( clockCenterX + ( sin(angle) * ( clockRadius - ( clockRadius / 2 ) ) ) );
  y3 = ( clockCenterY - ( cos(angle) * ( clockRadius - ( clockRadius / 2 ) ) ) );
  display.drawLine( clockCenterX  , clockCenterY , x3  , y3 );

  switch((currentSecond)%6){
    case 0:
   display.setFont(ArialMT_Plain_10);
    display.drawString(10,2 , "T");
    
    display.drawString(115,2 , "H");
    
    
    break;
   
    case 1:
     display.setFont(ArialMT_Plain_10);
  display.drawString(10,2 , "T");
    display.drawString(10,16 , "I");
   
    display.drawString(115,2 , "H");
    display.drawString(115,16 , "U");
    
    
   
     break;
    case 2:
     display.setFont(ArialMT_Plain_10);
    display.drawString(10,2 , "T");
    display.drawString(10,16 , "I");
    display.drawString(10,30 , "E");
  
    display.drawString(115,2 , "H");
    display.drawString(115,16 , "U");
    display.drawString(115,30 , "S");
    
    
     break;
    case 3:
     display.setFont(ArialMT_Plain_10);
    display.drawString(10,2 , "T");
    display.drawString(10,16 , "I");
    display.drawString(10,30 , "E");
    display.drawString(10,44 , "M");
    display.drawString(115,2 , "H");
    display.drawString(115,16 , "U");
    display.drawString(115,30 , "S");
    display.drawString(115,44 , "T");
     break;
    default:
     display.setFont(ArialMT_Plain_10);
    display.drawString(10,2 , "T");
    display.drawString(10,16 , "I");
    display.drawString(10,30 , "E");
    display.drawString(10,44 , "M");
    display.drawString(115,2 , "H");
    display.drawString(115,16 , "U");
    display.drawString(115,30 , "S");
    display.drawString(115,44 , "T");
    break;
    
    }

  
  display.display();

}

void digitalClockFrame( int16_t x, int16_t y) {
   display.clear();
   
  String currentDate =String(monthDay) + "-" + String(currentMonth) + "-" +String(currentYear) ;
  String timenow = String(currentHour)+":"+String(currentMinute)+":"+String(currentSecond);
  display.setTextAlignment(TEXT_ALIGN_CENTER);
  
    display.setFont(ArialMT_Plain_10);
  display.drawString(clockCenterX + x, 0, String(weekDay) );
   display.setFont(ArialMT_Plain_16);
  display.drawString(clockCenterX + x , 15, currentDate );
  display.setFont(ArialMT_Plain_24);
  display.drawString(clockCenterX + x , clockCenterY + y, timenow );
  display.display();
 
  
}


void connectWifi()
{
  Serial.printf("Connecting to %s \n", ssid);

  //WiFi.config(staticIP, gateway, subnet);
  WiFi.begin(ssid, password);
  while (WiFi.status() != WL_CONNECTED)
  {
    delay(200);
    Serial.print(".");
  }
  Serial.println();
  Serial.print("Connected, IP address: ");
  Serial.println(WiFi.localIP());
  Serial.println();
  server.begin();
}


void recv() {
  WiFiClient client = server.available();
  // wait for a client (web browser) to connect
  if (client)
  {
    Serial.println("connected!");
    while (client.connected())
    {
      if (client.available())
      {

        char line[4];
        memset(line, 0, 4);
        client.readBytes(line, 4);
        frame = (int)line[0];
        pwmr = (int)line[1];
        pwmg = (int)line[2];
        pwmb = (int)line[3];
        Serial.println(line);
      }


    }
    delay(1); // give the web browser time to receive the data

    // close the connection:
    client.stop();
    Serial.println("[Client disonnected]");
  }

  Serial.println("out");
}



void setup() {
  Serial.begin(115200);
  
  pinMode(red, OUTPUT);
  pinMode(green, OUTPUT);
  pinMode(blue, OUTPUT);
  connectWifi();
  
  display.init();
  display.flipScreenVertically();
  display.setFont(ArialMT_Plain_10);
  timeClient.begin();
  timeClient.setTimeOffset(25200);
}


void loop() {
 // testdrawbitmap(logo_bmp, 60, 120);
   switch (frame-48) {
          case 0:
            testdrawbitmap(logo_bmp, 60, 120);
            Serial.println("0");
            break;
          case 1:
            testdrawbitmap(logo_bmp1, 60, 116);
            Serial.println("1");
            break;
          case 2 :
            testdrawbitmap(logo_bmp2, 62, 121);
            Serial.println("2");
            break;
          case 3:
            timeClient.update();
            unsigned long epochTime = timeClient.getEpochTime();
            currentHour = timeClient.getHours(); 
            currentMinute = timeClient.getMinutes();
            currentSecond = timeClient.getSeconds();
            weekDay = weekDays[timeClient.getDay()];
            struct tm *ptm = gmtime ((time_t *)&epochTime); 
            monthDay = ptm->tm_mday;
            currentMonth = ptm->tm_mon+1;
            currentMonthName = months[currentMonth-1];
            currentYear = ptm->tm_year+1900;
            digitalClockFrame(0,0);
            Serial.println("3");
            break; 
          
        }
        if(frame -48==5){
         
            timeClient.update();
            unsigned long epochTime = timeClient.getEpochTime();
            currentHour = timeClient.getHours();
            currentMinute = timeClient.getMinutes();
            currentSecond = timeClient.getSeconds();
            analogClockFrame();
            Serial.println(currentHour) ; 
            Serial.println(currentMinute) ; 
            Serial.println(currentSecond) ; 
          
          }
        analogWrite(green,(pwmg-48)*(102)); 
        analogWrite(red,(pwmg-48)*(102));
        analogWrite(blue,(pwmb-48)*(102));
        recv(); 


}
